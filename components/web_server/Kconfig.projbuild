## components/web_server/Kconfig.projbuild
```kconfig
menu "Delivery Robot WiFi Configuration"

    config WIFI_SSID
        string "WiFi SSID"
        default "myssid"
        help
            The WiFi network the robot connects to. Set via idf.py menuconfig.

    config WIFI_PASSWORD
        string "WiFi Password"
        default "mypassword"
        help
            WPA2 password for the above network. Set via idf.py menuconfig.

endmenu
```
